## board/Kconfig
```kconfig
menu "Hardware Drivers Config"

config SOC_STM32F427II
    bool
    select SOC_SERIES_STM32F4
    select RT_USING_COMPONENTS_INIT
    select RT_USING_USER_MAIN
    default y

menu "Onboard Peripheral Drivers"
    config BSP_USING_SDCARD
        bool "Enable SDCARD (sdio)"
        select BSP_USING_SDIO
        select RT_USING_DFS
        select RT_USING_DFS_ELMFAT
        default n

    config BSP_USING_ARDUINO
        bool "Compatible with Arduino Ecosystem (RTduino)"
        select PKG_USING_RTDUINO
        select BSP_USING_STLINK_TO_USART
        select BSP_USING_GPIO
        select BSP_USING_ADC
        select BSP_USING_ADC1
        select BSP_USING_PWM
        select BSP_USING_PWM2
        select BSP_USING_PWM2_CH1
        select BSP_USING_PWM2_CH2
        select BSP_USING_PWM2_CH3
        select BSP_USING_PWM2_CH4
        select BSP_USING_PWM4
        select BSP_USING_PWM4_CH1
        select BSP_USING_PWM4_CH2
        select BSP_USING_PWM4_CH3
        select BSP_USING_PWM4_CH4
        select BSP_USING_PWM5
        select BSP_USING_PWM5_CH1
        select BSP_USING_PWM5_CH2
        select BSP_USING_PWM5_CH3
        select BSP_USING_PWM5_CH4
        select BSP_USING_PWM8
        select BSP_USING_PWM8_CH1
        select BSP_USING_PWM8_CH2
        select BSP_USING_PWM8_CH3
        select BSP_USING_PWM8_CH4
        select BSP_USING_PWM12
        select BSP_USING_PWM12_CH1
        select BSP_USING_I2C
        select BSP_USING_I2C1
        imply RTDUINO_USING_SERVO
        imply RTDUINO_USING_WIRE
        default n

endmenu

menu "On-chip Peripheral Drivers"

    config BSP_USING_GPIO
        bool "Enable GPIO"
        select RT_USING_PIN
        default y

    menuconfig BSP_USING_UART
        bool "Enable UART"
        default y
        select RT_USING_SERIAL
        if BSP_USING_UART
            config BSP_USING_UART6
                bool "Enable UART6 (debug usart)"
                default y
            config BSP_UART6_RX_USING_DMA
                bool "Enable UART6 RX DMA"
                depends on BSP_USING_UART6 && RT_SERIAL_USING_DMA
                default n

            config BSP_USING_UART3
                bool "Enable UART3"
                default n
            config BSP_UART3_RX_USING_DMA
                bool "Enable UART3 RX DMA"
                depends on BSP_USING_UART3 && RT_SERIAL_USING_DMA
                default n

            config BSP_USING_UART7
                bool "Enable UART7"
                default n
            config BSP_UART7_RX_USING_DMA
                bool "Enable UART7 RX DMA"
                depends on BSP_USING_UART7 && RT_SERIAL_USING_DMA
                default n

            config BSP_USING_UART8
                bool "Enable UART8"
                default n
            config BSP_UART8_RX_USING_DMA
                bool "Enable UART8 RX DMA"
                depends on BSP_USING_UART8 && RT_SERIAL_USING_DMA
                default n

            config BSP_USING_UART1
                bool "Enable UART1 (DBUS)"
                default n
            config BSP_UART1_RX_USING_DMA
                bool "Enable UART1 RX DMA"
                depends on BSP_USING_UART1 && RT_SERIAL_USING_DMA
                default n
        endif

    menuconfig BSP_USING_CAN
            bool "Enable CAN"
            default n
            select RT_USING_CAN
            if BSP_USING_CAN
                config BSP_USING_CAN1
                    bool "using CAN1"
                    default n
                config BSP_USING_CAN2
                    bool "using CAN2"
                    default n
        endif

    config BSP_USING_SDIO
        bool "Enable SDIO"
        select RT_USING_SDIO
        select RT_USING_DFS
        default n

    menuconfig BSP_USING_ADC
        bool "Enable ADC"
        default n
        select RT_USING_ADC
        if BSP_USING_ADC
            config BSP_USING_ADC1
                bool "Enable ADC1"
                default n
        endif

    menuconfig BSP_USING_I2C
        bool "Enable I2C BUS"
        default n
        select RT_USING_I2C
        select RT_USING_I2C_BITOPS
        select RT_USING_PIN

        if BSP_USING_I2C
            config BSP_USING_I2C1
                bool "Enable I2C1 Bus (User I2C)"
                default n
                if BSP_USING_I2C1
                    comment "Notice: PE4 --> 68; PE5 --> 69"
                    config BSP_I2C1_SCL_PIN
                        int "i2c1 SCL pin number"
                        range 1 176
                        default 68
                    config BSP_I2C1_SDA_PIN
                        int "i2c1 SDA pin number"
                        range 1 176
                        default 69
                endif
        endif

    menuconfig BSP_USING_PWM
        bool "Enable PWM"
        default n
        select RT_USING_PWM
        if BSP_USING_PWM

            menuconfig BSP_USING_PWM12
                bool "Enable timer12 output PWM"
                default n
                if BSP_USING_PWM12
                    config BSP_USING_PWM12_CH1
                        bool "Enable PWM12 channel1(buzzer) "
                        default n
                endif

            menuconfig BSP_USING_PWM4
                bool "Enable timer4 output PWM"
                default n
                if BSP_USING_PWM4
                    config BSP_USING_PWM4_CH1
                        bool "Enable PWM4 channel1"
                        default n
                    config BSP_USING_PWM4_CH2
                        bool "Enable PWM4 channel2"
                        default n
                    config BSP_USING_PWM4_CH3
                        bool "Enable PWM4 channel3"
                        default n
                    config BSP_USING_PWM4_CH4
                        bool "Enable PWM4 channel4"
                        default n
                endif

            menuconfig BSP_USING_PWM5
                bool "Enable timer5 output PWM"
                default n
                if BSP_USING_PWM5
                    config BSP_USING_PWM5_CH1
                        bool "Enable PWM5 channel1"
                        default n
                    config BSP_USING_PWM5_CH2
                        bool "Enable PWM5 channel2"
                        default n
                    config BSP_USING_PWM5_CH3
                        bool "Enable PWM5 channel3"
                        default n
                    config BSP_USING_PWM5_CH4
                        bool "Enable PWM5 channel4"
                        default n
                endif

            menuconfig BSP_USING_PWM3
                bool "Enable timer3 output PWM"
                default n
                if BSP_USING_PWM3
                    config BSP_USING_PWM3_CH1
                        bool "Enable PWM3 channel1"
                        default n
                    config BSP_USING_PWM3_CH2
                        bool "Enable PWM3 channel2"
                        default n
                    config BSP_USING_PWM3_CH3
                        bool "Enable PWM3 channel3"
                        default n
                    config BSP_USING_PWM3_CH4
                        bool "Enable PWM3 channel4"
                        default n
                endif

            menuconfig BSP_USING_PWM2
                bool "Enable timer2 output PWM"
                default n
                if BSP_USING_PWM2
                    config BSP_USING_PWM2_CH1
                        bool "Enable PWM2 channel1"
                        default n
                    config BSP_USING_PWM2_CH2
                        bool "Enable PWM2 channel2"
                        default n
                    config BSP_USING_PWM2_CH3
                        bool "Enable PWM2 channel3"
                        default n
                    config BSP_USING_PWM2_CH4
                        bool "Enable PWM2 channel4"
                        default n
                endif

            menuconfig BSP_USING_PWM8
                bool "Enable timer8 output PWM"
                default n
                if BSP_USING_PWM8
                    config BSP_USING_PWM8_CH1
                        bool "Enable PWM8 channel1"
                        default n
                    config BSP_USING_PWM8_CH2
                        bool "Enable PWM8 channel2"
                        default n
                    config BSP_USING_PWM8_CH3
                        bool "Enable PWM8 channel3"
                        default n
                    config BSP_USING_PWM8_CH4
                        bool "Enable PWM8 channel4"
                        default n
                endif
        endif
    menuconfig BSP_USING_ADC
        bool "Enable ADC"
        default n
        select RT_USING_ADC
        if BSP_USING_ADC
            config BSP_USING_ADC1
                bool "Enable ADC1"
                default n
            config BSP_USING_ADC3
                bool "Enable ADC3"
                default n
        endif

    menuconfig BSP_USING_SPI
        bool "Enable SPI BUS"
        default n
        select RT_USING_SPI
        if BSP_USING_SPI
            config BSP_USING_SPI1
                bool "Enable SPI1 BUS"
                default n

            config BSP_SPI1_TX_USING_DMA
                bool "Enable SPI1 TX DMA"
                depends on BSP_USING_SPI1
                default n

            config BSP_SPI1_RX_USING_DMA
                bool "Enable SPI1 RX DMA"
                depends on BSP_USING_SPI1
                select BSP_SPI1_TX_USING_DMA
                default n

            config BSP_USING_SPI2
                bool "Enable SPI2 BUS"
                default n

            config BSP_SPI2_TX_USING_DMA
                bool "Enable SPI2 TX DMA"
                depends on BSP_USING_SPI2
                default n

            config BSP_SPI2_RX_USING_DMA
                bool "Enable SPI2 RX DMA"
                depends on BSP_USING_SPI2
                select BSP_SPI2_TX_USING_DMA
                default n

            config BSP_USING_SPI5
                bool "Enable SPI5 BUS"
                default n

            config BSP_SPI5_TX_USING_DMA
                bool "Enable SPI5 TX DMA"
                depends on BSP_USING_SPI5
                default n

            config BSP_SPI5_RX_USING_DMA
                bool "Enable SPI5 RX DMA"
                depends on BSP_USING_SPI5
                select BSP_SPI5_TX_USING_DMA
                default n
        endif

    menuconfig BSP_USING_I2C1
        bool "Enable I2C1 BUS (software simulation)"
        default n
        select RT_USING_I2C
        select RT_USING_I2C_BITOPS
        select RT_USING_PIN
        if BSP_USING_I2C1
            comment "Notice: PA8 --> 8; PC9 --> 41"
            config BSP_I2C1_SCL_PIN
                int "i2c1 scl pin number"
                default 8
            config BSP_I2C1_SDA_PIN
                int "I2C1 sda pin number"
                default 41
        endif

    source "libraries/HAL_Drivers/Kconfig"
endmenu

menu "RoboMaster Modules"
    menuconfig BSP_USING_MOTOR
        bool "Select USING Motors"
        default y
        if BSP_USING_MOTOR
            config BSP_USING_DJI_MOTOR
                bool "Using DJI Motors"
                default y
        endif

    config BSP_USING_DWT
        bool "Enable DWT"
        default y

    config BSP_USING_PS_MSG
        bool "Enable Pub Sub Message"
        default y

    menuconfig BSP_USING_MAG
        bool "Enable Magnetometer"
        default y
        if BSP_USING_MAG
            config BSP_USING_IST8310
                bool "Using IST8310"
                default y
        endif

    menuconfig BSP_USING_IMU
        bool "Enable IMU"
        default y
        if BSP_USING_IMU
            config BSP_USING_MPU6500
                bool "Using MPU6500"
                default y
        endif

    config BSP_USING_RC_SBUS
        bool "Enable RC SBUS"
        default y

    menuconfig BSP_USING_RC_DBUS
        bool "Enable RC DBUS"
        default n
        if BSP_USING_RC_DBUS
            config BSP_USING_RC_KEYBOARD
                bool "Using KEYBOARD"
                default n
        endif

endmenu

menu "RoboMaster Algorithms"
    config BSP_USING_PID
        bool "Select USING PID Controller"
        default y

    config BSP_USING_QUATERNIONESF
       bool "Select USING QuaternionEKF"
       default y
       select BSP_USING_KALMAN_FILTER

    config BSP_USING_KALMAN_FILTER
       bool "Select USING KalmanFilter"
       default y
    config BSP_USING_RAMP
       bool "Select USING Ramp"
       default y

endmenu

menu "RoboMaster Tasks"
    config BSP_USING_EXAMPLE_TASK
        bool "Select USING Example Task"
        default n

    config BSP_USING_INS_TASK
        bool "Select USING Ins Task"
        default y

    config BSP_USING_MOTOR_TASK
        bool "Select USING Motor Task"
        default y

    config BSP_USING_CMD_TASK
        bool "Select USING Cmd Task"
        default y

    menuconfig BSP_USING_CHASSIS_TASK
        bool "Select USING Chassis Task"
        default y
        if BSP_USING_CHASSIS_TASK
            config BSP_CHASSIS_OMNI_MODE
                bool "Select Chassis Omni Mode"
                default y
            config BSP_CHASSIS_MECANUM_MODE
                bool "Select Chassis Mecanum Mode"
                default n
        endif

    config BSP_USING_GIMBAL_TASK
        bool "Select USING Gimbal Task"
        default y

    config BSP_USING_TRANSMISSION_TASK
        bool "Select USING Transmission Task"
        default y

    config BSP_USING_SHOOT_TASK
        bool "Select USING Shoot Task"
        default y

    config BSP_USING_REFEREE_TASK
        bool "Select USING Referee Task"
        default y

endmenu

menu "Board extended module Drivers"

endmenu

endmenu
```
